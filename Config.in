## Config.in
```kconfig
# Add the external packages you need to here
source "$BR2_EXTERNAL_MINIC_CONTAINER_PATH/package/etcd/Config.in"
```

## configs/template_defconfig
```kconfig
BR2_x86_64=y
BR2_CCACHE=y
BR2_TOOLCHAIN_BUILDROOT_GLIBC=y
BR2_GCC_VERSION_4_9_X=y
BR2_INIT_NONE=y
# BR2_TARGET_ENABLE_ROOT_LOGIN is not set
BR2_SYSTEM_BIN_SH_BASH=y
# BR2_TARGET_GENERIC_GETTY is not set
# BR2_TARGET_GENERIC_REMOUNT_ROOTFS_RW is not set
BR2_TARGET_TZ_INFO=y
BR2_ROOTFS_POST_BUILD_SCRIPT="$(BR2_EXTERNAL_MINIC_CONTAINER_PATH)/board/minic/template/post-build.sh"
BR2_PACKAGE_BUSYBOX_CONFIG="$(BR2_EXTERNAL_MINIC_CONTAINER_PATH)/board/minic/common/busybox.config"
BR2_PACKAGE_BUSYBOX_SHOW_OTHERS=y
BR2_TARGET_ROOTFS_TAR_GZIP=y

# Add the packages or config below
# BR2_PACKAGE_ETCD=y
# BR2_PACKAGE_FLANNEL=y
```
